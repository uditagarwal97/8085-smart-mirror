# SW_REG EQU 80H
# PORTA EQU 81H
# PORTB EQU 82H
# PORTC EQU 83H
# ORG 0000H
	   JMP MAIN
# ORG MAIN

MAIN:	   LXI SP,80FF	// STACK POINTER INITIALIZE
	   LXI H,1000	// MEMORY POINTER
	   CALL PPI_INIT	// INITIALIZE PPI FOR LCD
// ESP CODE
	   MVI E,00

LOOP:	   RIM
	   ANI 80
	   JNZ LOOP
	   MVI B,1D	// 150uSEC DELAY
	   CALL DELAY
	   RIM
	   ANI 80
	   MVI D,07	// 7 TIMES SHIFT RIGHT
	   CALL SHIFT
	   ORA E
	   MOV E,A
// YHA TK 1 BIT MIL GAI
	   MVI B,06
	   CALL DELAY
	   RIM
	   ANI 80
	   MVI D,06	// 6 TIMES SHIFT RIGHT
	   CALL SHIFT
	   ORA E
	   MOV E,A
// YHA TK 2 BIT MIL GAI
	   MVI B,06
	   CALL DELAY
	   RIM
	   ANI 80
	   MVI D,05	// 5 TIMES SHIFT RIGHT
	   CALL SHIFT
	   ORA E
	   MOV E,A
// YHA TK 3 BIT MIL GAI
	   MVI B,06
	   CALL DELAY
	   RIM
	   ANI 80
	   MVI D,04	// 4 TIMES SHIFT RIGHT
	   CALL SHIFT
	   ORA E
	   MOV E,A
// YHA TK 4 BIT MIL GAI
	   MVI B,06
	   CALL DELAY
	   RIM
	   ANI 80
	   MVI D,03	// 3 TIMES SHIFT RIGHT
	   CALL SHIFT
	   ORA E
	   MOV E,A
// YHA TK 5 BIT MIL GAI
	   MVI B,06
	   CALL DELAY
	   RIM
	   ANI 80
	   MVI D,02	// 2 TIMES SHIFT RIGHT
	   CALL SHIFT
	   ORA E
	   MOV E,A
// YHA TK 6 BIT MIL GAI
	   MVI B,06
	   CALL DELAY
	   RIM
	   ANI 80
	   MVI D,01	// 1 TIMES SHIFT RIGHT
	   CALL SHIFT
	   ORA E
	   MOV E,A
// YHA TK 7 BIT MIL GAI
	   MVI B,06
	   CALL DELAY
	   RIM
	   ANI 80	// ISME SHIFT NAHI HOGA
	   ORA E
	   MOV E,A
// YHA TK 8 BIT MIL GAI
	   STA 8001
	   CPI 41
	   MVI A,07
	   OUT PORTB
	   HLT

SHIFT:	   RRC
	   DCR D
	   JNZ SHIFT
	   RET

PPI_INIT:	   MVI A,0F	// PORTA,B,C OUTPUT MODE
	   OUT SW_REG
	   XRA A	// CLEAR ACCUMULATOR
	   OUT PORTA	// SET PORTA ZERO
	   OUT PORTC	// SET PORTC ZERO
	   MVI A,01
	   OUT PORTB	// BACKLIGHT ON
	   RET

DELAY:	   DCR B	// ARGUEMENT MUST BE PASSED IN B REG
	   JNZ DELAY
	   RET

LCD_INIT:	   MVI D,38	// DL - 2,FONT 5X7
	   CALL SEND_CMND
	   MVI D,0C	// DISPLAY ON,CURSOR OFF,BLINK OFF
	   CALL SEND_CMND
	   MVI D,06	// CURSOR INCREMENT
	   CALL SEND_CMND
	   RET

SEND_CMND:	   MOV A,D	// GET ARGUEMENT FROM D REGISTER
	   OUT PORTA
	   MVI A,02	// RS = 0, EN = 1
	   OUT PORTC
	   XRA A
	   OUT PORTC	// RS = 0, EN = 0
	   MVI B,03
	   CALL DELAY
	   RET

PRINTLOOP:	   MOV A,M	// FETCH DATA FROM MEMORY
	   OUT PORTA
	   MVI A,03	// RS = 1, EN = 1
	   OUT 83
	   MVI A,01	// RS = 1, EN = 0
	   OUT 83
	   MVI B,02
	   CALL DELAY	// DELAY FOR 30 uSEC
	   INX H	// INCREMENT MEM POINTER
	   DCR C
	   JNZ PRINTLOOP
	   RET
# ORG 1000H
# DB 38H,30H,38H,35H,42H,41H,53H,45H,44H,53H,4DH,41H,52H,54H,4DH,49H,52H,52H,4FH,52H
